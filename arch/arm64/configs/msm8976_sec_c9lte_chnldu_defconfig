## arch/arm64/configs/msm8976_sec_c9lte_chnldu_defconfig
```kconfig
CONFIG_SEC_C9LTE_PROJECT=y
CONFIG_MACH_C9LTE_CHN_OPEN=y

#SKU theme
CONFIG_SKU_THEME=y

#
# MAX77843 IC
#
# CONFIG_EXTCON is not set
# CONFIG_EXTCON_MAX77843 is not set
# CONFIG_MFD_MAX77843 is not set

# MUIC
CONFIG_USE_MUIC=y
CONFIG_MUIC_NOTIFIER=y
CONFIG_MUIC_UNIVERSAL=y
CONFIG_MUIC_UNIVERSAL_SM5705=y
CONFIG_MUIC_UNIVERSAL_SM5705_AFC=y
CONFIG_MUIC_SM5705_AFC_18W_TA_SUPPORT=y
CONFIG_MUIC_PINCTRL=y
CONFIG_MUIC_SM5705_SWITCH_CONTROL_GPIO=y

# RUSTPROOF
CONFIG_MUIC_SUPPORT_RUSTPROOF=y

# VBUS_NOTI
CONFIG_VBUS_NOTIFIER=y

#HALL IC
#CONFIG_SENSORS_HALL=y
#CONFIG_CERTIFY_HALL=y

# Service LED
# CONFIG_LEDS_MAX77843_RGB is not set
CONFIG_LEDS_SM5705_RGB=y
CONFIG_LEDS_CLASS=y


#
# MOTOR
#
CONFIG_SS_VIBRATOR=y

#
# DISPLAY(MDSS)
#
CONFIG_PANEL_S6E3FA3_AMS598KH01_FHD=y

#FLASH
CONFIG_FLASHLIGHT=y
CONFIG_SM_FLASH_LED=y
CONFIG_LEDS_SM5705=y
CONFIG_DUAL_LEDS_FLASH=y

#CAMERA
CONFIG_MSM_FRONT_EEPROM=y

# XO SHUTDOWN
CONFIG_UART3=y

# BATTERY & Charger
# CONFIG_FUELGAUGE_MAX77843 is not set
# CONFIG_FUELGAUGE_MAX77843_COULOMB_COUNTING is not set
# CONFIG_CHARGER_MAX77843 is not set
CONFIG_SAMSUNG_LPM_MODE=y
CONFIG_BATTERY_SAMSUNG=y
CONFIG_AFC_CHARGER_MODE=y
CONFIG_PREVENT_SOC_JUMP=y
CONFIG_CHARGER_SM5705=y
CONFIG_FUELGAUGE_SM5705=y
CONFIG_SEC_MPP_SHARE=y
CONFIG_SW_SELF_DISCHARGING=y
CONFIG_BATTERY_SWELLING=y
CONFIG_AFC_CHARGER_MODE=y
CONFIG_STEP_CHARGING=y
CONFIG_MULTI_CHARGING=y
CONFIG_BATTERY_SAMSUNG_V2_FOLDER=y
CONFIG_BATTERY_NOTIFIER=y
CONFIG_INBATVOLT_FG=y
# CONFIG_CHARGER_BQ25898S is not set (for EVB REV00)
# DA9155 for EVB REV01
CONFIG_CHARGER_DA9155=y
CONFIG_STORE_MODE=y
CONFIG_CHANGE_VBUS_VOLTAGE=y

#Power off Alarm
CONFIG_RTC_AUTO_PWRON=y
CONFIG_RTC_AUTO_PWRON_PARAM=y

#
# InputDevice
#
CONFIG_TOUCHSCREEN_MELFAS_MMS549=y
CONFIG_KEYBOARD_ABOV_TOUCH_18XX=y
CONFIG_KEYBOARD_ABOV_TOUCH_16XX=y
CONFIG_TOUCHSCREEN_DUMP_MODE=y
CONFIG_SECURE_TOUCH=y

# CONFIG_MFD_S2MPB02 is not set
# CONFIG_REGULATOR_S2MPB02 is not set
CONFIG_MFD_SM5705=y
CONFIG_REGULATOR_SM5705=y

# Finger print sensor
CONFIG_SENSORS_FINGERPRINT=y
CONFIG_SENSORS_FINGERPRINT_SYSFS=y
CONFIG_SENSORS_ET510=y
CONFIG_SENSORS_FP_SPI_NUMBER=4
CONFIG_SENSORS_FP_SPI_GPIO_START=12
CONFIG_SENSORS_FP_SPI_GPIO_END=15

#
# Sensor
#
CONFIG_SENSORS_SSP=y
CONFIG_SENSORS_SSP_STM32f=y
CONFIG_SENSORS_SSP_TMD3700=y
CONFIG_SENSORS_SSP_6AXIS=y
CONFIG_SENSORS_SSP_AK09916=y
CONFIG_SENSORS_SSP_ATUC128L5HAR=y
#CONFIG_SENSORS_SSP_BMP280=y
CONFIG_IIO=y
CONFIG_IIO_BUFFER=y
CONFIG_IIO_KFIFO_BUF=y
CONFIG_IIO_TRIGGER=y
CONFIG_SENSORS_CORE=y



#NFC
CONFIG_NFC=y
CONFIG_SEC_NFC=y
CONFIG_ESE_P3=y
CONFIG_ESE_SECURE=y
CONFIG_ESE_SECURE_SPI_PORT=0
CONFIG_ESE_SPI_GPIO_START=0
CONFIG_ESE_SPI_GPIO_END=3

# GPIO EXPANDER
CONFIG_GPIO_PCAL6416A=y

#
# Audio
#
CONFIG_SND_SOC_MSM8X16_CS47L15=y
CONFIG_SND_SOC_MSM8X16_WCD=y
CONFIG_AUDIO_SPEAKER_OUT_NXP_AMP_ENABLE=y
CONFIG_SND_SOC_ARIZONA=y
CONFIG_SND_SOC_WM_ADSP=y
CONFIG_SND_SOC_CS47L15=y
CONFIG_MFD_ARIZONA=y
CONFIG_MFD_ARIZONA_SPI=y
CONFIG_MFD_CS47L15=y
CONFIG_SWITCH_ARIZONA=y
CONFIG_REGULATOR_ARIZONA=y
CONFIG_MFD_WM5102=n
CONFIG_MFD_WM5110=n

# Earjack
#CONFIG_SAMSUNG_JACK=y
CONFIG_INPUT_GPIO=y
CONFIG_SW_100K_TO_GND=y

#MST
CONFIG_MST_LDO=y
# CONFIG_SCHED_TASK_BEHAVIOR is not set

# SSWAP
CONFIG_SWAP=y
CONFIG_FRONTSWAP=y
CONFIG_ZSMALLOC=y
CONFIG_ZSMALLOC_STAT=y
CONFIG_ZSMALLOC_OBJ_SEQ=n
CONFIG_PGTABLE_MAPPING=y
CONFIG_ZSWAP=y
CONFIG_ZSWAP_ENABLE_WRITEBACK=n
CONFIG_ZSWAP_COMPACTION=y
CONFIG_ZPOOL=y
CONFIG_DIRECT_RECLAIM_FILE_PAGES_ONLY=y
CONFIG_INCREASE_MAXIMUM_SWAPPINESS=y
CONFIG_FIX_INACTIVE_RATIO=y
CONFIG_TIGHT_PGDAT_BALANCE=y
CONFIG_VNSWAP=y
CONFIG_SWAP_ENABLE_READAHEAD=n

CONFIG_ANDROID_INTF_ALARM_DEV=y


# CCIC
CONFIG_CCIC_NOTIFIER=y
CONFIG_CCIC_S2MM005=y
CONFIG_SEC_EXT=y
CONFIG_SEC_SYSFS=y
CONFIG_MUIC_SUPPORT_CCIC=y
CONFIG_USB_TYPEC_MANAGER_NOTIFIER=y
CONFIG_CCIC_LPM_ENABLE=y
CONFIG_USB_NOTIFY_PROC_LOG=y
CONFIG_USB_HOST_NOTIFY=y
CONFIG_USB_EXTERNAL_NOTIFY=y
CONFIG_USB_DEBUG_DETAILED_LOG=y
CONFIG_CCIC_S2MM005_PD_DISABLE=y


# SECURITY
CONFIG_FIPS_ENABLE=n

CONFIG_KNOX_KAP=y
```

## drivers/debug/Kconfig
```kconfig
# When adding new entries keep the list in alphabetical order

config USER_RESET_DEBUG
	bool "reset reason debug feature in user version"
	depends on SEC_DEBUG
	default n
	help
	  This option enables debugging log for B10 project.
	  This option provides reset history log in user version.
	  This option enable proc/reset_reason support
```

## drivers/motor/Kconfig
```kconfig
config MOTOR_DRV_MAX77843
        tristate "Maxim MAX77843 motor"
        default n
	depends on MFD_MAX77843

config MSM_VIBRATOR
	tristate "MSM_VIBRATOR"
	default n
	help
	  Say Y to enable MSM_VIBRATOR support

config SS_VIBRATOR
	tristate "SS_VIBRATOR"
	default n
	help
	  Say Y to enable SAMSUNG VIBRATOR support

config DC_MOTOR_PMIC
	tristate "DC_MOTOR_PMIC"
	default n
	help
	  Say Y to enable MOTOR DC drive by PMIC support
```
